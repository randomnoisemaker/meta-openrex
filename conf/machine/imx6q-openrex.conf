## conf/machine/imx6q-openrex.conf
```bitbake
#@TYPE: Machine
#@NAME: NXP i.MX6QP/Q/DL OpenRex
#@SOC: i.MX6QP/Q/DL
#@DESCRIPTION: Machine configuration for Fedevel i.MX6QP/Q/DL OpenRex 
#@MAINTAINER: Fernando Vitorero <vitorero@gmail.com>
#
# This machine replaces the following machines:
#    * imx6qpsabresd
#    * imx6qsabresd
#    * imx6dlsabresd
#    * imx6solosabresd
# and is able to work for all the machines.

MACHINEOVERRIDES =. "mx6:mx6q:mx6dl:"

require conf/machine/include/imx-base.inc
require conf/machine/include/tune-cortexa9.inc

PREFERRED_PROVIDER_u-boot_mx6 = "u-boot-openrex"
PREFERRED_PROVIDER_virtual/kernel_mx6 = "linux-openrex"
PREFERRED_VERSION_linux-openrex-imx ?= "5.4"

KERNEL_DEVICETREE = "imx6q-openrex.dtb"

KERNEL_DEVICETREE_use-mainline-bsp = "imx6q-openrex.dtb"

UBOOT_MACHINE ?= "mx6openrex_defconfig"

# Use fslc u-boot by default. See also imx-base.inc.
UBOOT_MAKE_TARGET = "all"
UBOOT_SUFFIX = "img"
SPL_BINARY = "SPL"
WKS_FILE = "imx-uboot-spl-bootpart.wks.in"

# The fsl distro uses u-boot-imx which does not provide unified functionality
# for dl/q/qp SoC variants. Change the defconfig to the targeted SoC variant.
UBOOT_MACHINE_fsl = "mx6openrex_defconfig"

SERIAL_CONSOLES = "115200;ttymxc0"

MACHINE_FIRMWARE_append_mx6 = " linux-firmware-ath6k"

MACHINE_FEATURES += " pci wifi bluetooth"
```
